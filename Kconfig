## Kconfig
```kconfig
# Copyright (c) 2026 Leonardo Fazzini
# SPDX-License-Identifier: Apache-2.0

rsource "drivers/serial/Kconfig.ibex_uart"
rsource "drivers/timer/Kconfig.ibex_timer"
```

## boards/lowrisc/secure_ibex/Kconfig.secure_ibex
```kconfig
# Copyright (c) 2026 Leonardo Fazzini
# SPDX-License-Identifier: Apache-2.0

config BOARD_SECURE_IBEX
	select SOC_SECURE_IBEX
```

## boards/lowrisc/secure_ibex/board.yml
```yaml
board:
  name: secure_ibex
  full_name: Secure-Ibex Reference System on Arty A7
  vendor: lowrisc
  socs:
  - name: secure_ibex
```

## boards/lowrisc/secure_ibex/secure_ibex_defconfig
```kconfig
# Copyright (c) 2026 Leonardo Fazzini
# SPDX-License-Identifier: Apache-2.0

CONFIG_SERIAL=y
CONFIG_CONSOLE=y
CONFIG_UART_CONSOLE=y
CONFIG_UART_INTERRUPT_DRIVEN=y
CONFIG_BUILD_OUTPUT_BIN=y
CONFIG_XIP=n

# Shell support — uses polling backend because the Ibex UART has no
# hardware TX interrupt (only RX IRQ). The interrupt-driven TX path
# stalls after the first FIFO fill since no ISR fires to refill it.
CONFIG_SHELL=y
CONFIG_SHELL_BACKEND_SERIAL=y
CONFIG_SHELL_BACKEND_SERIAL_API_POLLING=y
```

## drivers/serial/Kconfig.ibex_uart
```kconfig
# Copyright (c) 2026 Leonardo Fazzini
# SPDX-License-Identifier: Apache-2.0

config UART_IBEX
	bool "Ibex Reference System UART driver"
	default y
	depends on DT_HAS_LOWRISC_IBEX_UART_ENABLED
	select SERIAL_HAS_DRIVER
	select SERIAL_SUPPORT_INTERRUPT
	help
	  Enable the UART driver for the Ibex Reference System.
	  Simple 3-register UART with RX/TX FIFOs (128 bytes each).
	  Supports polling and interrupt-driven modes.
	  HW interrupt is RX-only (level: RX FIFO not empty);
	  TX is kick-started in software.
```

## drivers/timer/Kconfig.ibex_timer
```kconfig
# Copyright (c) 2026 Leonardo Fazzini
# SPDX-License-Identifier: Apache-2.0

config IBEX_TIMER
	bool "Ibex Reference System timer driver"
	default y
	depends on DT_HAS_LOWRISC_IBEX_TIMER_ENABLED
	select TICKLESS_CAPABLE
	select TIMER_HAS_64BIT_CYCLE_COUNTER
	help
	  Custom system clock driver for the Ibex Reference System
	  machine timer (64-bit mtime/mtimecmp at 0x80000000).
```

## dts/bindings/serial/lowrisc,ibex-uart.yaml
```yaml
# Copyright (c) 2026 Leonardo Fazzini
# SPDX-License-Identifier: Apache-2.0

description: |
  Ibex Reference System UART controller.
  Simple 3-register UART: RX (0x0), TX (0x4), STATUS (0x8).
  STATUS bit 0 = RX FIFO empty, bit 1 = TX FIFO full.

compatible: "lowrisc,ibex-uart"

include: uart-controller.yaml

properties:
  reg:
    required: true

  clock-frequency:
    type: int
    description: SoC clock frequency driving the UART (used for baud calc in HW, not SW)

  interrupts-extended:
    description: IRQ line for RX data available (level-triggered when RX FIFO not empty)
```

## dts/bindings/timer/lowrisc,ibex-timer.yaml
```yaml
# Copyright (c) 2026 Leonardo Fazzini
# SPDX-License-Identifier: Apache-2.0

description: |
  Ibex Reference System machine timer.

  64-bit mtime counter incrementing every clock cycle (50 MHz).
  IRQ asserted when mtime >= mtimecmp, cleared by writing mtimecmp.

  Register map (from hw/Secure-Ibex/vendor/lowrisc_ibex/shared/rtl/timer.sv):
    0x00  MTIME_LOW      R/W  lower 32 bits of mtime
    0x04  MTIME_HIGH     R/W  upper 32 bits of mtime
    0x08  MTIMECMP_LOW   R/W  lower 32 bits of mtimecmp
    0x0C  MTIMECMP_HIGH  R/W  upper 32 bits of mtimecmp

compatible: "lowrisc,ibex-timer"

include: base.yaml

properties:
  reg:
    required: true
  interrupts-extended:
    required: true
```

## soc/lowrisc/secure_ibex/Kconfig
```kconfig
# Copyright (c) 2026 Leonardo Fazzini
# SPDX-License-Identifier: Apache-2.0

config SOC_SECURE_IBEX
	select ATOMIC_OPERATIONS_C
	select INCLUDE_RESET_VECTOR
	select RISCV
	select RISCV_PRIVILEGED
	select RISCV_VECTORED_MODE
	select GEN_IRQ_VECTOR_TABLE
```

## soc/lowrisc/secure_ibex/Kconfig.defconfig
```kconfig
# Copyright (c) 2026 Leonardo Fazzini
# SPDX-License-Identifier: Apache-2.0

if SOC_SECURE_IBEX

config SYS_CLOCK_HW_CYCLES_PER_SEC
	default 50000000

config NUM_IRQS
	default 32

endif # SOC_SECURE_IBEX
```

## soc/lowrisc/secure_ibex/Kconfig.soc
```kconfig
# Copyright (c) 2026 Leonardo Fazzini
# SPDX-License-Identifier: Apache-2.0

config SOC_SECURE_IBEX
	bool

config SOC
	default "secure_ibex" if SOC_SECURE_IBEX
```
